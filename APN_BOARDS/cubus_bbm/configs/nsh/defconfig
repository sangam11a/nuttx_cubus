## custom_apps_here/downloader/Kconfig
```kconfig
#
# For a description of the syntax of this configuration file,
# see the file kconfig-language.txt in the NuttX tools repository.
#

config CUSTOM_APPS_DOWNLOADER
	tristate "\"Downloader, data!\" example"
	default n
	---help---
		Enable the \"custom Hello, World!\" example

if CUSTOM_APPS_DOWNLOADER

config CUSTOM_APPS_DOWNLOADER_PROGNAME
	string "Program name"
	default "downloader"
	---help---
		This is the name of the program that will be used when the NSH ELF
		program is installed.

config CUSTOM_APPS_DOWNLOADER_PRIORITY
	int "Downloader task priority"
	default 100

config CUSTOM_APPS_DOWNLOADER_STACKSIZE
	int "Downloader stack size"
	default DEFAULT_TASK_STACKSIZE

endif
```

## custom_apps_here/mpu6500/Kconfig
```kconfig
#
# For a description of the syntax of this configuration file,
# see the file kconfig-language.txt in the NuttX tools repository.
#

config CUSTOM_APPS_MPU6500
	tristate "start MPU6500 sensor"
	default n
	---help---
		start mpu6500 sensor data collection

if CUSTOM_APPS_MPU6500

config CUSTOM_APPS_MPU6500_PROGNAME
	string "Program name"
	default "mpu6500"
	---help---
		This is the name of the program that will be used when the NSH ELF
		program is installed.

config CUSTOM_APPS_MPU6500_PRIORITY
	int "mpu6500 task priority"
	default 100

config CUSTOM_APPS_MPU6500_STACKSIZE
	int "MPU6500 stack size"
	default DEFAULT_TASK_STACKSIZE

config IMU_NO
  int "no of IMU devices"
  default 1


config IMU0_PATH
  string "path of first IMU device"
  default "/dev/mpu6500"
  ---help---
    This is the device location of first IMU device

if IMU_NO > 1

config IMU1_PATH
  string "path of second IMU device"
  default "/dev/mpu6500_1"

if IMU_NO > 2

config IMU2_PATH
  string "path of third IMU device"
  default "/dev/mpu6500_2"

endif

endif

endif
```

## custom_apps_here/spi_adc_test/Kconfig
```kconfig
#
# For a description of the syntax of this configuration file,
# see the file kconfig-language.txt in the NuttX tools repository.
#

config CUSTOM_APPS_SPI_ADC_TEST
	tristate "\"Spi_test, World!\" example"
	default n
	---help---
		Enable the \"Spi_test, World!\" example

if CUSTOM_APPS_SPI_ADC_TEST

config CUSTOM_APPS_SPI_ADC_TEST_PROGNAME
	string "Program name"
	default "spi_adc_test"
	---help---
		This is the name of the program that will be used when the NSH ELF
		program is installed.

config CUSTOM_APPS_SPI_ADC_TEST_PRIORITY
	int "Spi_test task priority"
	default 100

config CUSTOM_APPS_SPI_ADC_TEST_STACKSIZE
	int "Spi_test stack size"
	default DEFAULT_TASK_STACKSIZE

endif
```

## custom_apps_here/spi_driver_test/Kconfig
```kconfig
#
# For a description of the syntax of this configuration file,
# see the file kconfig-language.txt in the NuttX tools repository.
#

config CUSTOM_APPS_SPI_DRIVER_TEST
	tristate "Lis3mdl SPI device test example application"
	default n
	---help---
		Enable the LIS3MDL SPI device test example application

if CUSTOM_APPS_SPI_DRIVER_TEST

config CUSTOM_APPS_SPI_DRIVER_TEST_PROGNAME
	string "Program name"
	default "spi_driver_test"
	---help---
		This is the name of the program that will be used when the NSH ELF
		program is installed.

config CUSTOM_APPS_SPI_DRIVER_TEST_PRIORITY
	int "spi device driver test priority"
	default 100

config CUSTOM_APPS_SPI_DRIVER_TEST_STACKSIZE
	int "spi device driver test stack size"
	default DEFAULT_TASK_STACKSIZE

endif
```
