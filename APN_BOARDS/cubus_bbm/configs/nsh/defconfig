## APN_BOARDS/cubus_em11/Kconfig
```kconfig
#
# For a description of the syntax of this configuration file,
# see the file kconfig-language.txt in the NuttX tools repository.
#

if CONFIG_ARCH_BOARD_CUSTOM	

config ARCH_BOARD_CUSTOM_DIR_RELPATH
	bool "option defines the presence of relaitve DIR path"
	default y
	---help---
		Activating the presence of relative path to custom board config

config ARCH_BOARD_CUSTOM_DIR
	string "relative custom board directory"
	default "../APN_BOARDS/cubus_bbm"
	---help---
		Relative board directroy for custom board configurations

config ARCH_BOARD_CUSTOM_NAME
	string "name of board"
	default "cubus_bbm"
	---help---
		Name of the custom board defined by user

config ARCH_BOARD_CUSTOM_HIGHPRI
	bool "High priority interrupt test"
	default n
endif
```

## custom_apps/com_app/Kconfig
```kconfig
#
# For a description of the syntax of this configuration file,
# see the file kconfig-language.txt in the NuttX tools repository.
#

config CUSTOM_APPS_COM_APP
	tristate "COM APP"
	default n
	---help---
		Enable the \"COM APP \". The COM app deals with receiving of data

if CUSTOM_APPS_COM_APP

config CUSTOM_APPS_COM_APP_PROGNAME
	string "Program name"
	default "com"
	---help---
		This is the name of the program that will be used when the NSH ELF
		program is installed.


config CUSTOM_APPS_COM_APP_PRIORITY
	int "COM app task priority"
	default 100

config CUSTOM_APPS_COM_APP_STACKSIZE
	int "COM_APP stack size"
	default DEFAULT_TASK_STACKSIZE

endif
```

## custom_apps/cubus_app/Kconfig
```kconfig
#
# For a description of the syntax of this configuration file,
# see the file kconfig-language.txt in the NuttX tools repository.
#

config CUSTOM_APPS_CUBUS_APP
	tristate "CUBUS APP"
	default n
	---help---
		Enable the \"CUBUS APP \" 

if CUSTOM_APPS_CUBUS_APP

config CUSTOM_APPS_CUBUS_APP_PROGNAME
	string "Program name"
	default "Cubus"
	---help---
		This is the name of the program that will be used when the NSH ELF
		program is installed.

config CUSTOM_APPS_CUBUS_APP_SAMPLE_RATE
	int "Number of samples to acquire for IMU sensors"
	default 100

config CUSTOM_APPS_CUBUS_USE_EXT_ADC
	bool "Use external ADC"
	default n
	---help---
		Select if we need to use the external ADC. 

config CUSTOM_APPS_CUBUS_USE_INT_ADC1
	bool "Use internal ADC1"
	default n
	depends on ADC && BOARDCTL
	---help---
		Enable internal ADC1 for Cubus 

if CUSTOM_APPS_CUBUS_USE_INT_ADC1

config CUSTOM_APPS_CUBUS_INT_ADC1_DEVPATH
	string "ADC1 device path"
	default "/dev/adc0"
	---help---
		The default path to the ADC1 device. Default: /dev/adc0

config CUSTOM_APPS_CUBUS_INT_ADC1_NSAMPLES
	int "Number of Sample Groups"
	default 0
	---help---
		This number of samples is collected and the program terminates.
		Default:  0 (samples are collected indefinitely).

config CUSTOM_APPS_CUBUS_INT_ADC1_GROUPSIZE
	int "Number of Samples per Group"
	default 4
	---help---
		The number of samples to read at once. Default: 4

config CUSTOM_APPS_CUBUS_INT_ADC1_SWTRIG
	bool "Use software trigger"
	default n
	---help---
		Some ADCs may be configured so there is no automatic or periodic
		conversion of samples.  Rather, the ADC sampling must be trigger by
		software via an ioctl command.  Select this option only if
		applicable for your ADC configuration.  In this case, the test will
		issue the software trigger ioctl before attempting to read from the
		ADC.

endif

config CUSTOM_APPS_CUBUS_USE_INT_ADC3
	bool "Use internal ADC3"
	default n
	depends on ADC && BOARDCTL
	---help---
		Enable internal ADC3 for Cubus 

if CUSTOM_APPS_CUBUS_USE_INT_ADC3

config CUSTOM_APPS_CUBUS_INT_ADC3_DEVPATH
	string "ADC1 device path"
	default "/dev/adc1"
	---help---
		The default path to the ADC3 device. Default: /dev/adc0

config CUSTOM_APPS_CUBUS_INT_ADC3_NSAMPLES
	int "Number of Sample Groups"
	default 0
	---help---
		This number of samples is collected and the program terminates.
		Default:  0 (samples are collected indefinitely).

config CUSTOM_APPS_CUBUS_INT_ADC3_GROUPSIZE
	int "Number of Samples per Group"
	default 4
	---help---
		The number of samples to read at once. Default: 4

config CUSTOM_APPS_CUBUS_INT_ADC3_SWTRIG
	bool "Use software trigger"
	default n
	---help---
		Some ADCs may be configured so there is no automatic or periodic
		conversion of samples.  Rather, the ADC sampling must be trigger by
		software via an ioctl command.  Select this option only if
		applicable for your ADC configuration.  In this case, the test will
		issue the software trigger ioctl before attempting to read from the
		ADC.

endif

config CUSTOM_APPS_CUBUS_APP_PRIORITY
	int "Cubus app task priority"
	default 100

config CUSTOM_APPS_CUBUS_APP_STACKSIZE
	int "Cubus_app stack size"
	default DEFAULT_TASK_STACKSIZE

endif
```

## custom_apps/gpio_control/Kconfig
```kconfig
#
# For a description of the syntax of this configuration file,
# see the file kconfig-language.txt in the NuttX tools repository.
#

config CUSTOM_APPS_GPIO_CONTROL
	tristate "GPIO pins control application"
	default n
	---help---
		Enable or Disable gpio pins for Cubus as required

if CUSTOM_APPS_GPIO_CONTROL

config CUSTOM_APPS_GPIO_CONTROL_PROGNAME
	string "Program name"
	default "GPIO_CONTROL"
	---help---
		This is the name of the program that will be used when the NSH ELF
		program is installed.

config CUSTOM_APPS_GPIO_CONTROL_PRIORITY
	int "GPIO control application priority"
	default 100

config CUSTOM_APPS_GPIO_CONTROL_STACKSIZE
	int "GPIO control application stack size"
	default DEFAULT_TASK_STACKSIZE

endif
```

## custom_apps/hk_main/Kconfig
```kconfig
#
# For a description of the syntax of this configuration file,
# see the file kconfig-language.txt in the NuttX tools repository.
#

config CUSTOM_APPS_HK_MAIN
	tristate "Housekeeping data process"
	default n
	---help---
		Enable the Housekeeping data process application" example

if CUSTOM_APPS_HK_MAIN

config CUSTOM_APPS_HK_MAIN_PROGNAME
	string "Program name"
	default "hkmain"
	---help---
		This is the name of the program that will be used when the NSH ELF
		program is installed.

config CUSTOM_APPS_HK_MAIN_PRIORITY
	int "Housekeeping(HK) Main task priority"
	default 100

config CUSTOM_APPS_HK_MAIN_STACKSIZE
	int "Housekeeping(HK) main stack size"
	default DEFAULT_TASK_STACKSIZE

config CUSTOM_APPS_HK_MAIN_PRIORITY
	int "Housekeeping(HK) Main task priority"
	default 100

config CUSTOM_APPS_IMU_SPI_NUMBER
	int "Set spi number for IMU sensor"
	default 5

config CUSTOM_APPS_EADC_SPI_NUMBER
	int "Set spi number for IMU sensor"
	default 2

endif
```

## custom_apps/mag_main/Kconfig
```kconfig
#
# For a description of the syntax of this configuration file,
# see the file kconfig-language.txt in the NuttX tools repository.
#

config CUSTOM_APPS_MAG_MAIN
	tristate "Magnetometer data process"
	default n
	---help---
		Enable the magnetometer data process application" example

if CUSTOM_APPS_MAG_MAIN

config CUSTOM_APPS_MAG_MAIN_PROGNAME
	string "Program name"
	default "magmain"
	---help---
		This is the name of the program that will be used when the NSH ELF
		program is installed.

config CUSTOM_APPS_MAG_MAIN_PRIORITY
	int "Mag Main task priority"
	default 100

config CUSTOM_APPS_MAG_MAIN_STACKSIZE
	int "mag main stack size"
	default DEFAULT_TASK_STACKSIZE

endif
```

## custom_apps/storage_manager/Kconfig
```kconfig
#
# For a description of the syntax of this configuration file,
# see the file kconfig-language.txt in the NuttX tools repository.
#

config CUSTOM_APPS_STORAGE_MANAGER
	tristate "An app for managing all the data writing in a single storage point"
	default n
	---help---
		Enable the An app for managing all the data writing in a single storage point

if CUSTOM_APPS_STORAGE_MANAGER

config CUSTOM_APPS_STORAGE_MANAGER_PROGNAME
	string "Program name"
	default "storage_manager"
	---help---
		This is the name of the program that will be used when the NSH ELF
		program is installed.

config CUSTOM_APPS_STORAGE_MANAGER_PRIORITY
	int "Storage manager app priority"
	default 100

config CUSTOM_APPS_STORAGE_MANAGER_STACKSIZE
	int "Storage manager app stack size"
	default DEFAULT_TASK_STACKSIZE

endif
```

## custom_apps_here/adc/Kconfig
```kconfig
#
# For a description of the syntax of this configuration file,
# see the file kconfig-language.txt in the NuttX tools repository.
#

config CUSTOM_APPS_INT_ADC
	tristate "Internal ADC Operations"
	default n
	depends on ADC && BOARDCTL
	---help---
		Enable the ADC example

if CUSTOM_APPS_INT_ADC

config CUSTOM_APPS_INT_ADC_PROGNAME
  string "Name of the application"
  default "int_adc"
  
config CUSTOM_APPS_INT_ADC_PRIORITY
  int "Internal ADC operation task priority"
  default 100

config CUSTOM_APPS_INT_ADC_STACKSIZE
  int "Cubus app stack size"
  default DEFAULT_TASK_STACKSIZE

config CUSTOM_APPS_ADC_USE_INT_ADC1
  bool "use Interal ADC1"
  default n
  ---help---
    Enable internal ADC1

config CUSTOM_APPS_ADC_USE_INT_ADC2
  bool "use Internal ADC2"
  default n
  ---help---
    Enable internal ADC2

config CUSTOM_APPS_ADC_USE_INT_ADC3
  bool "use Internal ADC3"
  default n
  ---help---
    Enable internal ADC3

if CUSTOM_APPS_ADC_USE_INT_ADC1

config CUSTOM_APPS_INT_ADC1_DEVPATH
  string "Internal ADC1 Device path"
  default "/dev/adc0"
  ---help---
    The Path of the internal ADC 1.

config CUSTOM_APPS_INT_ADC1_NSAMPLES
  int "Number of sample groups for internal ADC 1"
  default 0
  ---help---
    The number of samples to collect before  the program terminates.
    Default: 0 (Samples are collected indefinitely)

config CUSTOM_APPS_INT_ADC1_GROUPSIZE
  int "Number of samples per group"
  default 16
  ---help---
    The number of samples to read at once. Default: 16 (All channels including temperature and VrefInt).

config CUSTOM_APPS_INT_ADC1_SWTRIG
  bool "Enable INT ADC1 software trigger"
  default n
  ---help---
    Some ADC may be configured so there is no automatic or periodic
    conversion of samples. Rather, the ADC sampling must  be trigger
    by software via an ioctl command. Select this options only if applicable
    for your ADC configuration. In this case, the test will issue the software 
    trigger ioctl before attempting to read from the adc.

endif

if CUSTOM_APPS_ADC_USE_INT_ADC2

config CUSTOM_APPS_INT_ADC2_DEVPATH
  string "Internal ADC2 Device path"
  default "/dev/adc1"
  ---help---
    The Path of the internal ADC 1.

config CUSTOM_APPS_INT_ADC2_NSAMPLES
  int "Number of sample groups for internal ADC 2"
  default 0
  ---help---
    The number of samples to collect before  the program terminates.
    Default: 0 (Samples are collected indefinitely)

config CUSTOM_APPS_INT_ADC2_GROUPSIZE
  int "Number of samples per group"
  default 16
  ---help---
    The number of samples to read at once. Default: 16 (All channels including temperature and VrefInt).

config CUSTOM_APPS_INT_ADC2_SWTRIG
  bool "Enable INT ADC2 software trigger"
  default n
  ---help---
    Some ADC may be configured so there is no automatic or periodic
    conversion of samples. Rather, the ADC sampling must  be trigger
    by software via an ioctl command. Select this options only if applicable
    for your ADC configuration. In this case, the test will issue the software 
    trigger ioctl before attempting to read from the adc.

endif

if CUSTOM_APPS_ADC_USE_INT_ADC3

config CUSTOM_APPS_INT_ADC3_DEVPATH
  string "Internal ADC3 Device path"
  default "/dev/adc2"
  ---help---
    The Path of the internal ADC 3.

config CUSTOM_APPS_INT_ADC3_NSAMPLES
  int "Number of sample groups for internal ADC 3"
  default 0
  ---help---
    The number of samples to collect before  the program terminates.
    Default: 0 (Samples are collected indefinitely)

config CUSTOM_APPS_INT_ADC3_GROUPSIZE
  int "Number of samples per group"
  default 1
  ---help---
    The number of samples to read at once. Default: 16 (All channels including temperature and VrefInt).

config CUSTOM_APPS_INT_ADC3_SWTRIG
  bool "Enable INT ADC3 software trigger"
  default n
  ---help---
    Some ADC may be configured so there is no automatic or periodic
    conversion of samples. Rather, the ADC sampling must  be trigger
    by software via an ioctl command. Select this options only if applicable
    for your ADC configuration. In this case, the test will issue the software 
    trigger ioctl before attempting to read from the adc.

endif

endif
```

## custom_apps_here/ads7953/Kconfig
```kconfig
#
# For a description of the syntax of this configuration file,
# see the file kconfig-language.txt in the NuttX tools repository.
#

config CUSTOM_APPS_ADS7953
	tristate "Start ADS7953 ADC"
	default n
	---help---
		Start ADS7953 Analog data collector

if CUSTOM_APPS_ADS7953

config CUSTOM_APPS_ADS7953_PROGNAME
	string "Program name"
	default "ads7953"
	---help---
		This is the name of the program that will be used when the NSH ELF
		program is installed.

config CUSTOM_APPS_ADS7953_PRIORITY
	int "ads7953 task priority"
	default 100

config CUSTOM_APPS_ADS7953_STACKSIZE
	int "Ads7953 stack size"
	default DEFAULT_TASK_STACKSIZE

config IOCTL_MODE
  bool "Enable IOCTL mode operation"
  default y
  

config EXT_ADC_NO
  int "no of ADC devices"
  default 1


config EADC0_PATH
  string "path of first external ADC device"
  default "/dev/eadc0"
  ---help---
    This is the device location of first External ADC device

config EADC0_CHAN_NO
  int "No of channels for EXT ADC 0"
  default 12
  ---help---
    No of channels being used on external ADC 0. The channels needs to be activated serially, from 0.

if EXT_ADC_NO > 1

config EADC1_PATH
  string "path of second external ADC device"
  default "/dev/eadc1"

config EADC1_CHAN_NO
  int "No of channels for EXT ADC 1"
  default 12
  ---help---
    No of channels being used on external ADC 1. The channels needs to be activated serially, from 0.
if EXT_ADC_NO > 2

config EADC2_PATH
  string "path of third exernal ADC device"
  default "/dev/eadc2"

config EADC2_CHAN_NO
  int "No of channles for EXT ADC 2"
  default 12
  ---help---
    No of channels being used on external ADC 2. The channls needs to be activated serially, from 0.
    

endif

endif

endif
```

## custom_apps_here/com_app/Kconfig
```kconfig
#
# For a description of the syntax of this configuration file,
# see the file kconfig-language.txt in the NuttX tools repository.
#

config CUSTOM_APPS_COM_APP
	tristate "COM APP"
	default n
	---help---
		Enable the \"COM APP \". The COM app deals with receiving of data

if CUSTOM_APPS_COM_APP

config CUSTOM_APPS_COM_APP_PROGNAME
	string "Program name"
	default "com"
	---help---
		This is the name of the program that will be used when the NSH ELF
		program is installed.



endif
```

## custom_apps_here/custom_hello/Kconfig
```kconfig
#
# For a description of the syntax of this configuration file,
# see the file kconfig-language.txt in the NuttX tools repository.
#

config CUSTOM_APPS_CUSTOM_HELLO
	tristate "\"custom Hello, World!\" example"
	default n
	---help---
		Enable the \"custom Hello, World!\" example

if CUSTOM_APPS_CUSTOM_HELLO

config CUSTOM_APPS_CUSTOM_HELLO_PROGNAME
	string "Program name"
	default "cushello"
	---help---
		This is the name of the program that will be used when the NSH ELF
		program is installed.

config CUSTOM_APPS_CUSTOM_HELLO_PRIORITY
	int "Custom Hello task priority"
	default 100

config CUSTOM_APPS_CUSTOM_HELLO_STACKSIZE
	int "Custom Hello stack size"
	default DEFAULT_TASK_STACKSIZE

endif
```
